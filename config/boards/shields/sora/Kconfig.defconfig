## config/boards/shields/sora/Kconfig.defconfig
```kconfig
if SHIELD_SORA_LEFT

config ZMK_KEYBOARD_NAME
  default "Sora"

config ZMK_SPLIT_ROLE_CENTRAL
  default y

# OLED Display 
config ZMK_DISPLAY
  default y

# I2C for OLED
config I2C
  default y

# SSD1306 Display Driver
config SSD1306
  default y

endif

if SHIELD_SORA_LEFT || SHIELD_SORA_RIGHT

config ZMK_SPLIT
  default y

endif
```

## config/boards/shields/sora/Kconfig.shield
```kconfig
config SHIELD_SORA_LEFT
  def_bool $(shields_list_contains,sora_left)

config SHIELD_SORA_RIGHT
  def_bool $(shields_list_contains,sora_right)
```
